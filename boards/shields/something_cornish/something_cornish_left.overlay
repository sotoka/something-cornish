#include "something_cornish.dtsi"
#include <dt-bindings/led/led.h>

/{
    chosen {
        zmk,underglow = &led_strip;
    };

    ext-power {
        compatible = "zmk,ext-power-generic";
        label = "EXT_POWER";
        control-gpios = <&gpio0 13 GPIO_ACTIVE_HIGH>;
        init-delay-ms = <50>;
    };
};

&kscan0 {
    col-gpios
        = <&gpio0 31 GPIO_ACTIVE_HIGH>
        , <&gpio0 29 GPIO_ACTIVE_HIGH>
        , <&gpio0 2 GPIO_ACTIVE_HIGH>
        , <&gpio1 15 GPIO_ACTIVE_HIGH>
        , <&gpio1  13 GPIO_ACTIVE_HIGH>
        , <&gpio1  11 GPIO_ACTIVE_HIGH>
        ;
};
