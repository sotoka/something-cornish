## boards/shields/something_cornish/Kconfig
```kconfig
config BOARD_CORNEISH_ZEN_LEFT
    bool

config BOARD_CORNEISH_ZEN_RIGHT
    bool
```

## boards/shields/something_cornish/Kconfig.defconfig
```kconfig
if SHIELD_SOMETHING_CORNISH_LEFT

config ZMK_KEYBOARD_NAME
    default "Cornish"

config ZMK_SPLIT_ROLE_CENTRAL
    default y

endif


if SHIELD_SOMETHING_CORNISH_LEFT || SHIELD_SOMETHING_CORNISH_RIGHT

config ZMK_SPLIT
    default y

config BT_CTLR
    default BT

config ZMK_EXT_POWER
    default y

config WS2812_STRIP
    default y

config ZMK_RGB_UNDERGLOW
    default y

config ZMK_RGB_UNDERGLOW_ON_START
    default n

config ZMK_RGB_UNDERGLOW_BRT_MAX
    default 80

config ZMK_RGB_UNDERGLOW_HUE_START
    default 160

config ZMK_RGB_UNDERGLOW_EFF_START
    default 3

if USB

config USB_NRFX
    default y

config USB_DEVICE_STACK
    default y

endif # USB
config ZMK_DISPLAY
    select LV_USE_CONT
    select LV_FONT_MONTSERRAT_26
    select LV_FONT_MONTSERRAT_16
    select LV_USE_LABEL
    select LV_USE_IMG

choice ZMK_DISPLAY_STATUS_SCREEN
    default ZMK_DISPLAY_STATUS_SCREEN_CUSTOM
endchoice

if ZMK_DISPLAY

config SPI
    default y

config IL0323
    default y

config ZMK_DISPLAY_BLANK_ON_IDLE
    default n

# Needed for the IL0323 driver which allocs memory to clear the display
config HEAP_MEM_POOL_SIZE
    default 1024

 config LV_Z_MEM_POOL_SIZE
     default 4096

endif # ZMK_DISPLAY

menuconfig CUSTOM_WIDGET_BATTERY_STATUS
    bool "custom battery status widget"

menuconfig CUSTOM_WIDGET_OUTPUT_STATUS
    bool "custom output status widget"

menuconfig CUSTOM_WIDGET_LAYER_STATUS
    bool "custom layer status widget"

menuconfig CUSTOM_WIDGET_PERIPHERAL_STATUS
    bool "custom peripheral status widget"

endif # BOARD_CORNEISH_ZEN_LEFT || BOARD_CORNEISH_ZEN_RIGHT


endif
```

## boards/shields/something_cornish/Kconfig.shield
```kconfig
config SHIELD_SOMETHING_CORNISH_LEFT
  def_bool $(shields_list_contains,something_cornish_left)

config SHIELD_SOMETHING_CORNISH_RIGHT
  def_bool $(shields_list_contains,something_cornish_right)
```
